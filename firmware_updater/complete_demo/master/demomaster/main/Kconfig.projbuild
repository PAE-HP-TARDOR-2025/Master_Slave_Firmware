## firmware_updater/complete_demo/master/demomaster/main/Kconfig.projbuild
```kconfig
menu "Master Uploader Configuration"

    config MASTER_NODE_ID
        int "CANopen node ID for master"
        default 1
        range 1 127
        help
            The CANopen node ID for this master device.

    config MASTER_TARGET_NODE_ID
        int "Target slave node ID (first slave)"
        default 10
        range 1 127
        help
            The CANopen node ID of the first slave to upload firmware to.
            Additional slaves follow consecutively (10, 11, 12, ...).

    config MASTER_NUM_SLAVES
        int "Number of slaves to update"
        default 1
        range 1 8
        help
            Number of slaves to update in parallel.
            Slaves are at node IDs: TARGET_NODE_ID, TARGET_NODE_ID+1, ...
            Maximum 8 slaves due to SDO client memory constraints.

    config MASTER_CAN_BITRATE_KBPS
        int "CAN bitrate (kbps)"
        default 500
        range 125 1000
        help
            CAN bus bitrate in kbps. Common values: 125, 250, 500, 1000.
            Must match the slave's bitrate.

    config MASTER_TWAI_TX_GPIO
        int "TWAI TX GPIO"
        default 5
        help
            GPIO pin for TWAI (CAN) transmit.

    config MASTER_TWAI_RX_GPIO
        int "TWAI RX GPIO"
        default 4
        help
            GPIO pin for TWAI (CAN) receive.

    config MASTER_USE_SPIFFS
        bool "Use SPIFFS for firmware storage"
        default y
        help
            Mount SPIFFS partition for storing firmware binaries.

    config MASTER_SPIFFS_BASE_PATH
        string "SPIFFS mount path"
        default "/spiffs"
        depends on MASTER_USE_SPIFFS
        help
            Base path where SPIFFS is mounted.

    config MASTER_SPIFFS_PARTITION_LABEL
        string "SPIFFS partition label"
        default "storage"
        depends on MASTER_USE_SPIFFS
        help
            Partition label for SPIFFS.

    config MASTER_FIRMWARE_PATH
        string "Firmware file path"
        default "/spiffs/slave_fw.bin"
        help
            Path to the firmware binary to upload.

    config MASTER_MAX_CHUNK_BYTES
        int "Maximum chunk size"
        default 256
        range 64 1024
        help
            Maximum bytes per SDO block transfer chunk.

    config MASTER_UPLOAD_ON_STARTUP
        bool "Upload firmware on startup"
        default y
        help
            Automatically start firmware upload when master boots.

    config MASTER_SKIP_IF_CRC_MATCH
        bool "Skip upload if CRC matches"
        default y
        help
            Query slave's running firmware CRC first and skip upload if it matches.

    config MASTER_FIRMWARE_VERSION
        int "Firmware version to send"
        default 1
        range 1 65535
        help
            Firmware version number (1-65535) to send in metadata.
            Must match the version in the slave firmware being uploaded.

endmenu
```

## firmware_updater/complete_demo/master/demomaster/sdkconfig.defaults
```kconfig
# Master Uploader sdkconfig defaults
# Copy this to sdkconfig or run idf.py menuconfig

CONFIG_IDF_TARGET="esp32"

# Partition table
CONFIG_PARTITION_TABLE_CUSTOM=y
CONFIG_PARTITION_TABLE_CUSTOM_FILENAME="partitions.csv"

# SPIFFS
CONFIG_MASTER_USE_SPIFFS=y
CONFIG_MASTER_SPIFFS_BASE_PATH="/spiffs"
CONFIG_MASTER_SPIFFS_PARTITION_LABEL="storage"

# Master configuration
CONFIG_MASTER_NODE_ID=1
CONFIG_MASTER_TARGET_NODE_ID=10
CONFIG_MASTER_NUM_SLAVES=1
CONFIG_MASTER_CAN_BITRATE_KBPS=1000
CONFIG_MASTER_TWAI_TX_GPIO=5
CONFIG_MASTER_TWAI_RX_GPIO=4
CONFIG_MASTER_FIRMWARE_PATH="/spiffs/slave_fw.bin"
CONFIG_MASTER_FIRMWARE_VERSION=2
CONFIG_MASTER_MAX_CHUNK_BYTES=512
CONFIG_MASTER_UPLOAD_ON_STARTUP=y
CONFIG_MASTER_SKIP_IF_CRC_MATCH=y

# Flash size
CONFIG_ESPTOOLPY_FLASHSIZE_4MB=y

# Logging - reduce to speed up transfer
CONFIG_LOG_DEFAULT_LEVEL_WARN=y
CONFIG_BOOTLOADER_LOG_LEVEL_WARN=y

# CAN bitrate 1Mbps
CONFIG_MASTER_CAN_BITRATE_KBPS=1000
```

## firmware_updater/complete_demo/slave/demoslave/main/Kconfig.projbuild
```kconfig
menu "Demo Slave Configuration"

    config DEMO_SLAVE_NODE_ID
        int "CANopen Node-ID"
        default 10
        range 1 127
        help
            CANopen node ID for the slave device.

    config DEMO_SLAVE_CAN_BITRATE_KBPS
        int "CAN bitrate (kbps)"
        default 1000
        range 125 1000
        help
            CAN bus bitrate in kbps. Use 1000 (1Mbps) for fastest transfers.
            Must match the master's bitrate.

    config DEMO_SLAVE_FW_VERSION
        int "Firmware version number"
        default 1
        range 1 65535
        help
            Firmware version number (1-65535). Increment this when releasing
            new firmware to ensure updates are applied even if CRC happens
            to match. The version is stored in NVS after successful OTA.

    config DEMO_SLAVE_MAX_CHUNK_BYTES
        int "Max OTA chunk size"
        default 512
        range 64 2048
        help
            Maximum bytes per firmware data chunk. Larger values result in
            faster transfers. Common values: 256, 512, 1024, 2048.

    config DEMO_SLAVE_MAX_IMAGE_BYTES
        int "Max image size (bytes)"
        default 524288
        range 65536 2097152
        help
            Maximum allowed firmware image size in bytes.

endmenu
```

## firmware_updater/complete_demo/slave/demoslave/sdkconfig.defaults
```kconfig
# SPDX-License-Identifier: MIT
# Minimal sdkconfig for demoslave example (ESP32 target)

CONFIG_IDF_TARGET="esp32"
CONFIG_DEMO_SLAVE_NODE_ID=10
CONFIG_DEMO_SLAVE_CAN_BITRATE_KBPS=1000
CONFIG_DEMO_SLAVE_MAX_CHUNK_BYTES=2048
CONFIG_DEMO_SLAVE_MAX_IMAGE_BYTES=524288

# Reduce logging to speed up transfer
CONFIG_LOG_DEFAULT_LEVEL_WARN=y
CONFIG_BOOTLOADER_LOG_LEVEL_WARN=y

# Use custom partition table with OTA support
CONFIG_PARTITION_TABLE_CUSTOM=y
CONFIG_PARTITION_TABLE_CUSTOM_FILENAME="../../partitions/slave_two_ota.csv"

# Flash size 4MB to fit OTA partitions
CONFIG_ESPTOOLPY_FLASHSIZE_4MB=y
```

## firmware_updater/library/slave/Kconfig.projbuild
```kconfig
menu "Firmware Update Server Configuration"

    config DEMO_SLAVE_NODE_ID
        int "CANopen Node-ID"
        default 10
        range 1 127
        help
            CANopen node ID for the slave device.

    config DEMO_SLAVE_CAN_BITRATE_KBPS
        int "CAN bitrate (kbps)"
        default 500
        range 125 1000
        help
            CAN bus bitrate in kbps.

    config DEMO_SLAVE_FW_VERSION
        int "Firmware version number"
        default 1
        range 1 65535
        help
            Firmware version number (1-65535). Increment this when releasing
            new firmware to ensure updates are applied even if CRC happens
            to match. The version is stored in NVS after successful OTA.

    config DEMO_SLAVE_MAX_CHUNK_BYTES
        int "Max OTA chunk size"
        default 256
        range 64 1024
        help
            Maximum number of bytes per OTA data chunk.

    config DEMO_SLAVE_MAX_IMAGE_BYTES
        int "Max firmware image size"
        default 524288
        range 65536 2097152
        help
            Maximum firmware image size in bytes (default 512KB).

endmenu
```

## firmware_updater/old/demo/demomaster/main/Kconfig.projbuild
```kconfig
menu "Demo master uploader settings"

config DEMO_MASTER_FW_PATH
    string "Firmware image path"
    default "/spiffs/bye.bin"
    help
        Absolute path to the firmware binary that will be streamed to the slave.
        Place the file on the mounted storage (for example SPIFFS or SD card)
        before powering up the demo master.

config DEMO_MASTER_NODE_ID
    int "Target slave node identifier"
    range 1 127
    default 10
    help
        CANopen node identifier of the slave that should receive the firmware image.

config DEMO_MASTER_TARGET_BANK
    int "Target firmware bank"
    range 0 255
    default 1
    help
        Bank number passed along with the metadata so the slave knows where to store the new image.

config DEMO_MASTER_CHUNK_BYTES
    int "Chunk size in bytes"
    range 32 1024
    default 256
    help
        Number of bytes sent per transfer chunk. This must match the limit configured on the slave side.

config DEMO_MASTER_NODE_ID_SELF
    int "Master node identifier"
    range 1 127
    default 100
    help
        CANopen node identifier that this ESP32 master uses when talking on the bus.
        Make sure it does not collide with any other masters on the network.

config DEMO_MASTER_CAN_BITRATE_KBPS
    int "TWAI bit rate (kbps)"
    range 50 1000
    default 500
    help
        Nominal CAN bus bit rate expressed in kilobits per second. The built-in
        driver currently supports 125, 250, 500, or 1000 kbps. Any other value
        will fall back to 500 kbps.

config DEMO_MASTER_TWAI_TX_GPIO
    int "TWAI TX GPIO"
    range 0 48
    default 5
    help
        GPIO number connected to the CAN transceiver TXD pin. The ESP32 drives
        this signal out to the bus.

config DEMO_MASTER_TWAI_RX_GPIO
    int "TWAI RX GPIO"
    range 0 48
    default 4
    help
        GPIO number connected to the CAN transceiver RXD pin. The ESP32 samples
        this signal coming from the bus.

config DEMO_MASTER_USE_SPIFFS
    bool "Mount SPIFFS at boot"
    default y
    help
        Automatically mount a SPI flash file system before the upload demo runs. Disable if you
        plan to source the firmware from another file system.

config DEMO_MASTER_SPIFFS_BASE_PATH
    string "SPIFFS mount path"
    depends on DEMO_MASTER_USE_SPIFFS
    default "/spiffs"
    help
        Base path where the SPI flash file system will be mounted.

config DEMO_MASTER_SPIFFS_PARTITION_LABEL
    string "SPIFFS partition label"
    depends on DEMO_MASTER_USE_SPIFFS
    default "storage"
    help
        Partition label declared in the partition table that stores the SPI flash file system.

config DEMO_MASTER_SPIFFS_FORMAT_IF_NEEDED
    bool "Format SPIFFS if mounting fails"
    depends on DEMO_MASTER_USE_SPIFFS
    default y
    help
        Reformat the SPI flash partition automatically when mounting fails.

endmenu
```

## firmware_updater/old/demo/demoslave/main/Kconfig.projbuild
```kconfig
menu "Dummy slave demo"

config SLAVE_GREETING
    string "Default slave greeting"
    default "Hello from slave"
    help
        Text printed by dummy_slave_main every second. You can override this
        option via menuconfig, a -DSLAVE_GREETING_OVERRIDE CMake definition,
        or by exporting SLAVE_GREETING_OVERRIDE in the environment before
        invoking idf.py.

config DEMO_SLAVE_NODE_ID
    int "Slave node identifier"
    range 1 127
    default 10
    help
        CANopen node ID used when announcing this slave on the bus.

config DEMO_SLAVE_CAN_BITRATE_KBPS
    int "TWAI bit rate (kbps)"
    range 50 1000
    default 500
    help
        Nominal CAN bus bit rate expressed in kilobits per second.

config DEMO_SLAVE_TWAI_TX_GPIO
    int "TWAI TX GPIO"
    range 0 48
    default 5
    help
        GPIO number wired to the CAN transceiver TXD pin.

config DEMO_SLAVE_TWAI_RX_GPIO
    int "TWAI RX GPIO"
    range 0 48
    default 4
    help
        GPIO number wired to the CAN transceiver RXD pin.

config DEMO_SLAVE_MAX_CHUNK_BYTES
    int "Maximum accepted chunk size"
    range 32 1024
    default 256
    help
        Largest firmware data block (in bytes) that the slave accepts in
        object 0x1F50. The master must stay at or below this limit.

config DEMO_SLAVE_MAX_IMAGE_BYTES
    int "Maximum firmware image size"
    range 65536 2097152
    default 524288
    help
        Upper bound for metadata validation. Images larger than this many
        bytes are rejected before any data is transferred.

endmenu
```

## firmware_updater/old/demo/esp-idf_slave/main/Kconfig.projbuild
```kconfig
menu "Firmware updater demo"

config SLAVE_GREETING
    string "Default slave greeting"
    default "Hello from slave"
    help
        Text printed by dummy_slave_main every second. You can override this
        option via menuconfig, a -DSLAVE_GREETING_OVERRIDE CMake definition,
        or by exporting SLAVE_GREETING_OVERRIDE in the environment before
        invoking idf.py.

endmenu
```
